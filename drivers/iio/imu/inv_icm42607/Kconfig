## drivers/iio/imu/inv_icm42607/Kconfig
```kconfig
# SPDX-License-Identifier: GPL-2.0
#
# ICM-42607 driver for Invensense/TDK IMU, ported from TDK release
# invensense-linux-driver-icm43600-10.0.2. Directory named after the
# part used on RDK X5 (ICM-42607-C, WHOAMI 0x61).

config INV_ICM42607
	tristate
	select IIO_BUFFER
	select IIO_TRIGGERED_BUFFER
	help
	  Invensense ICM-42607 driver core. Selected by the bus drivers,
	  do not enable directly. Rejects ICM-42688 (WHOAMI 0x47).

if INV_ICM42607

config INV_ICM42607_ICM43600
	bool
	default y

endif

config INV_ICM42607_I2C
	tristate "InvenSense ICM-42607 I2C driver"
	depends on I2C
	select INV_ICM42607
	help
	  This driver supports the InvenSense ICM-42607 motion tracking
	  device over I2C. It can be built as a module; the module will
	  be called inv-icm42607-i2c.

config INV_ICM42607_SPI
	tristate "InvenSense ICM-42607 SPI driver"
	depends on SPI_MASTER
	select INV_ICM42607
	help
	  This driver supports the InvenSense ICM-42607 motion tracking
	  device over SPI. It can be built as a module; the module will
	  be called inv-icm42607-spi.
```
