## drivers/soc/hobot/ddr_monitor/Kconfig
```kconfig
# SPDX-License-Identifier: GPL-2.0-only

config HOBOT_AXI_MONITOR
	tristate "Horizon AXI Performance Monitor"
	depends on ARCH_HOBOT
	default y
	help
	  Say y here to support horizon soc AXI master performance monitor.

config HOBOT_NOC_QOS
	tristate "Horizon Noc Qos Driver"
	depends on HOBOT_AXI_MONITOR
	default y
	help
	  Say y here to support horizon soc Noc Qos Driver.

config HOBOT_AXI_MONITOR_DEBUGFS
	bool "Horizon AXI Performance Monitor debug fs interfaces"
	depends on HOBOT_AXI_MONITOR
	depends on DEBUG_FS
	default y
	help
	  Say y here to enable horizon soc AXI master performance monitor
	  debugfs interface

# config HOBOT_AXI_MON_ADVANCED
# 	depends on HOBOT_AXI_MONITOR
# 	depends on n
# 	bool "Advanced configurations for Horizon AXI Performance Monitor"
# 	default n
# 	help
# 	  Say y here to support horizon soc AXI master performance monitor
# 	  advanced configurations. Say N if unsure.
```

## drivers/soc/hobot/debug/Kconfig
```kconfig
config HOBOT_HARDLOCKUP_DETECTOR
	bool "support the hard deadlock detection"
	help
	  support the hard deadlock detection.

config HOBOT_CORESIGHT
	bool "support coresight features"
	help
	  Support coresight features such as dump pcsr, trigger panic etc.
```

## drivers/soc/hobot/dsp/Kconfig
```kconfig
# SPDX-License-Identifier: GPL-2.0-only
#
# Hobot VDSP Acore Drivers
#

comment "Hobot DSP Acore Drivers"

config HOBOT_DSP
	tristate "dsp acore driver on HOBOT SoCs"
	depends on HOBOT_REMOTEPROC
	help
		This driver supports the horizon robotics dsp acore driver
```

## drivers/soc/hobot/firewall/Kconfig
```kconfig
# SPDX-License-Identifier: GPL-2.0-only

config DROBOT_FIREWALL
	tristate "Drobot MPU firewall "
	depends on ARCH_HOBOT
	default y
	help
	  Say y here to support drobot soc mpu firewall.
```

## drivers/soc/hobot/reboot_reason/Kconfig
```kconfig
# SPDX-License-Identifier: GPL-2.0-only

config SYSCON_REBOOT_REASON
	tristate "Generic SYSCON regmap reboot reason driver"
	depends on OF
	depends on MFD_SYSCON
	default y
	help
	  Say y here will enable reboot reason driver. This will
	  get reboot reason arguments and store it in SYSCON mapped
	  register, then the user can read it to know it's reboot
	  reason.

config DR_PANIC_ACTION
	bool "D-Robotics panic action driver"
	default y
	help
	  Panic action support for D-Robotics SoCs.
```

## drivers/soc/hobot/socinfo/Kconfig
```kconfig
# SPDX-License-Identifier: GPL-2.0-only

config HOBOT_SOCINFO
	tristate "horizon soc information"
	default y
	help
	  Say y here to support display horizon soc information.
```

## drivers/soc/hobot/vdsp/Kconfig
```kconfig
# SPDX-License-Identifier: GPL-2.0-only
#
# Hobot VDSP Acore Drivers
#

comment "Hobot VDSP Acore Drivers"

config HOBOT_VDSP
	tristate "vdsp acore driver on HOBOT SoCs"
	depends on HOBOT_REMOTEPROC
	help
		This driver supports the horizon robotics vdsp acore driver

config HOBOT_VDSP_STL
	tristate "VDSP STL driver"
	depends on HOBOT_DIAG_FUSA
	default y
	help
	  supports the horizon robotics vdsp acore stl driver
```

## drivers/staging/android/log/Kconfig
```kconfig
# SPDX-License-Identifier: GPL-2.0-only
#
# log driver
#

config ANDROID_LOGGER
	tristate "Android log driver"

config BOOTLOADER_LOG
	tristate "Bootloader log driver"
```

## net/tsn/Kconfig
```kconfig
config TSN
	tristate "802.1 TSN Support"
	depends on VLAN_8021Q && PTP_1588_CLOCK && CONFIGFS_FS
	help
	  Select this if you want to enable TSN on capable interfaces.
```

## sound/soc/archband/Kconfig
```kconfig
# SPDX-License-Identifier: GPL-2.0-only
config SND_ARCHBAND_PDM
	tristate "Archband PDM Device Driver"
	help
	 Say Y or M if you want to add support for PDM driver for
	 Archband PDM device. The device supports up to
	 a maximum of 8 channels each for play and record.

config SND_VIRT_CODEC
	tristate "Virtual Codec for archband PDM Driver"
	help
	 Say Y or M if you want to add virt codec
```

## sound/soc/gua/Kconfig
```kconfig
# SPDX-License-Identifier: GPL-2.0-only
#
# GUA SoC audio configuration
#

config SND_SOC_GUA
	tristate "SoC Audio support for GUA System-On-Chip"
	select HB_IPC_SHM
	help
		Say Y if you want to enable ASoC-support for
		any of the GUA platforms.
```

## sound/soc/hobot/Kconfig
```kconfig
# SPDX-License-Identifier: GPL-2.0-only
# Helper to resolve issues with configs that have SPI enabled but I2C
# modular, meaning we can't build the codec driver in with I2C support.
# We use an ordered list of conditional defaults to pick the appropriate
# setting - SPI can't be modular so that case doesn't need to be covered.

menu "SoundCard drivers"

config SND_SOC_HOBOT_SIMPLE_CARD
	tristate "Hobot simple card"

config SND_DUPLEX_CARD
	tristate "ASoC Duplex sound card support"
	select SND_SIMPLE_CARD_UTILS
	help
		This option enables generic simple sound card support

config SND_HOBOT_SOUND_MACHINE
	tristate "ASoC Hobot sound machine support"
	select SND_SIMPLE_CARD_UTILS
	help
		This option enables generic simple sound card support

config SND_HOBOT_SOUND_DUPLEX_HOST
	tristate "ASoC Hobot sound duplex host support"
	select SND_SIMPLE_CARD_UTILS
	help
		This option enables generic simple sound card support

endmenu
```
