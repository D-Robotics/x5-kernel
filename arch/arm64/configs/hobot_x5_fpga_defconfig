## drivers/clk/hobot/Kconfig
```kconfig
# SPDX-License-Identifier: GPL-2.0-only

config X5_CLK
	tristate "Horizon X5 clock support"
	default y
```

## drivers/crypto/te/Kconfig
```kconfig
if CRYPTO_HW

menu "Trust Engine Driver "
comment "Arm china Trust Engine Driver Config"

config CRYPTO_DEV_TE
	tristate "Support for arm China TrustEngine-600 enabled  security processors"
	depends on OF && CRYPTO_HW
	default m
	select CRYPTO_HASH
	select CRYPTO_SKCIPHER
	select CRYPTO_LIB_DES
	select CRYPTO_AEAD
	select CRYPTO_SHA1
	select CRYPTO_MD5
	select CRYPTO_SHA256
	select CRYPTO_SHA512
	select CRYPTO_HMAC
	select CRYPTO_AES
	select CRYPTO_CBC
	select CRYPTO_ECB
	select CRYPTO_CTR
	select CRYPTO_XTS
	select CRYPTO_RSA
	help
	  This selects the crypto driver for the TrustEngine-600 hardware. It supports
	  AES/SM4 with ECB, CBC, CTR, OFB and XTS modes. And for hash, it supports MD5,
	  SHA1, SHA224, SHA256, SHA384 and SHA512. it also supports GCM and CCM.

config HW_RANDOM_TE
	bool "Trust Engine HW Random Number Generator support"
        depends on HW_RANDOM  && CRYPTO_DEV_TE
	default y
	help
	  This driver provides kernel-side support for a generic Random
	  Number Generator.

config CRYPTO_TE_UT
	tristate "Support ARM China TrustEngine Unit Test"
	depends on CRYPTO_HW
	default m
	help
	  ARM China TrustEngine Unit Test driver supplies procfs interfaces for user
	  to manipulate and test the TrustEngine low-level drivers.

endmenu

endif # CRYPTO_HW
```

## drivers/gpu/drm/bridge/macrosilicon/Kconfig
```kconfig
config DRM_MS7210
	tristate "MS7210 BT1120/HDMI bridge"
	depends on OF
	select DRM_KMS_HELPER
	select REGMAP_I2C
	select I2C_MUX
	select SND_SOC_HDMI_CODEC if SND_SOC
	help
	  Driver for MS7210 BT1120 to HDMI bridge
	  chip driver.
```

## drivers/gpu/drm/bridge/verisilicon/Kconfig
```kconfig
# SPDX-License-Identifier: GPL-2.0-only

config VERISILICON_X5_SYSCON_BRIDGE
	tristate "Verisilicon Syscon X5 bridge support"
	depends on DRM_VERISILICON
	select MFD_SYSCON
	help
	  This bridge aims to support for subsystem level register access.
	  In display pipeline, there are always needs to access subsystem
	  level register, such as display mux to select which pipe is enabled.
	  Enable this option if you are using Verisilicon X5 SOC.
```

## drivers/gpu/drm/verisilicon/Kconfig
```kconfig
# SPDX-License-Identifier: GPL-2.0

config DRM_VERISILICON
	tristate "DRM Support for VeriSilicon"
	depends on DRM
	select DRM_KMS_HELPER
	help
	  Choose this option if you have a VeriSilicon soc chipset.
	  This driver provides VeriSilicon kernel mode
	  setting and buffer management. It does not
	  provide 2D or 3D acceleration.

config VERISILICON_DC8000_NANO
	bool "VeriSilicon DC8000 NANO driver support"
	depends on DRM_VERISILICON
	help
	  DC8000 NANO is a display controller supporting 1 video layer,
	  2 overlay layer and 1 cursor layer.
	  Say Y if you want to support DC8000 NANO serial display
	  controller.

config VERISILICON_BT1120
	bool "VeriSilicon BT1120 driver support"
	depends on DRM_VERISILICON
	help
	  BT1120 controller is compliant with ITU-R BT.1120 standards
	  which can be used to drive external HDMI device for 4K display.
	  Say Y if you want to support Verisilicon BT1120 display
	  controller.

config VERISILICON_SIMPLE_ENCODER
	bool "VeriSilicon simple encoder driver"
	depends on DRM_VERISILICON
	help
	  VeriSilicon simple encoder driver. This driver implements
	  basic function need by a encoder in display pipeline.
	  Say Y if you want to use drm_bridge drivers with
	  VeriSilicon DRM drivers.

config VERISILICON_DW_MIPI_DSI
	bool "VeriSilicon specific driver for Synopsys DW MIPI DSI"
	depends on DRM_VERISILICON
	select DRM_MIPI_DSI
	select GENERIC_PHY
	select GENERIC_PHY_MIPI_DPHY
	select VERISILICON_SIMPLE_ENCODER
	help
	  VeriSilicon specific driver for Synopsys DW MIPI DSI.
	  This driver supports Synopsys DW MIPI DSI controller.
	  MIPI DSI controller is a bridge between encoder
	  and panel. Also it is a MIPI DSI host and can work
	  in dual mode.

config VERISILICON_WRITEBACK
	bool
	depends on DRM_VERISILICON

choice
    prompt "Select the Writeback debug function"
    config DC8000_NANO_WRITEBACK_DEBUG
        bool "Writeback debug function for DC8000 Nano"
        select VERISILICON_WRITEBACK
        depends on VERISILICON_DC8000_NANO
        help
          This is a debug feature when DC8000 nano has writeback function
          integrated.
          Say Y if your hardware support this function and you want to use
          writeback function.

    config VERISILICON_WRITEBACK_SIF
        bool "Writeback function by SIF"
        select VERISILICON_WRITEBACK
        depends on VERISILICON_DC8000_NANO
        help
          Writeback function supported by SIF. SIF is an external IP from
          DC8000 nano. Using SIF, you have the capbility to use drm writeback
          function. Note this option should not be enabled simultaneously with
          DC8000_NANO_WRITEBACK_DEBUG.
endchoice

config VERISILICON_GEM_ION
	bool "GEM support ion interfaces"
	depends on ION
	help
	  VS GEM is able to using ION interfaces when ION is enabled. ION is a
	  generalized memory manager to address the issue of fragmented memory
	  management interfaces across different Android devices. ION also enables
	  its clients to share buffers, hence it treads the same ground as the DMA
	  buffer sharing framework (DMABUF).

config VERISILICON_GC_PROC_SUPPORT
	bool "VeriSilicon GC820 driver support"
	depends on DRM_VERISILICON
	help
	  GC820 is a 2D GPU which can extend the functionalities of DC8000 Nano,
	  such as multiple planes blending (max 8 planes), rotation, scaling.
	  Say Y if you want to support GC820 integration to Verisilicon drm
	  framework.

config VERISILICON_DEV_LINK_CNT
	int "max supplier devices count for drm device"
	default 32
	help
	  Specifies the max supplier devices that this driver support. Device
	  links are added between vs_drm device and other devices, such as
	  display controller, mipi dsi host, etc. In this way, specific
	  suspend/resume order can be promised. Because suspending vs_drm device
	  before other related devices is always desired.
```

## drivers/iio/imu/bmi088/Kconfig
```kconfig
#
# Makefile for Bosch sensors driver.
#
config BOSCH_DRIVER_LOG_FUNC
	tristate "Bosch BMI08X Sensortec driver smart log function support"
	depends on (I2C || SPI_MASTER) && SYSFS
	help
	  If you say yes here, you get support for smart log function in Bosch Sensortec driver.

config BMI08X_SUPPORT_I2C_BUS
	tristate "Bosch BMI08X I2C Driver"
	depends on I2C && SYSFS
	help
	  Build I2C driver for BMI08X combo sensor (accel + gyro in one driver).

config BMI08X_SUPPORT_SPI_BUS
	tristate "Bosch BMI08X SPI Drivers"
	depends on SPI_MASTER && SYSFS
	help
	  Select this to build SPI drivers for BMI08X series.
	  This will build both the accelerometer and gyroscope drivers.
```

## drivers/mailbox/hobot/Kconfig
```kconfig
# SPDX-License-Identifier: GPL-2.0-only
#
# Hobot mailbox drivers
#

comment "Hobot Mailbox Drivers"

source "drivers/mailbox/hobot/mbox/Kconfig"
source "drivers/mailbox/hobot/ipc/Kconfig"
```

## drivers/mailbox/hobot/ipc/Kconfig
```kconfig
comment "Hobot Mailbox Drivers"

config HB_IPC_SHM
	tristate "IPC base share memory for horizon"
	select HB_MBOX_PL320
	help
	  The ipc communication driver realized by horizon
```

## drivers/mailbox/hobot/mbox/Kconfig
```kconfig
# SPDX-License-Identifier: GPL-2.0-only
#
# Hobot mailbox drivers
#

comment "Hobot Mailbox Drivers"

config HB_MBOX_PL320
	tristate "ARM PL320 Mailbox for horizon"
	help
	  The mailbox communication driver realized by arm pl320 used by horizon
```

## drivers/media/platform/horizon/Kconfig
```kconfig
# SPDX-License-Identifier: GPL-2.0-only

#source "drivers/media/platform/horizon/camsys/Kconfig"

source "drivers/media/platform/horizon/codec/Kconfig"
```

## drivers/media/platform/horizon/codec/Kconfig
```kconfig
# HOBOT videosys configuration

config VIDEO_HOBOTC_JPU
    tristate "HOBOT C-series JPEG encoder & decoder driver"
    default n
    help
      Say Y here to enable support for HOBOT C-series JPEG driver.

config VIDEO_HOBOTC_VPU
    tristate "HOBOT C-series VPU encoder & decoder driver"
    default n
    help
      Say Y here to enable support for HOBOT C-series VSP driver.
```

## drivers/misc/verisilicon/gc8000l/Kconfig
```kconfig
# SPDX-License-Identifier: GPL-2.0

config VS_GC8000L
        tristate "Support for GC8000L basic features"
        help
          Select this option to enable driver support for verislicon gc8000l
          drivers.  GC8000L is a 3D gpu. This driver enables
          userspace programs to access these gpu hardware to configure.

          If unsure, say N.
```

## drivers/misc/verisilicon/gc820/Kconfig
```kconfig
# SPDX-License-Identifier: GPL-2.0-only

config HOBOT_VIO_N2D
	tristate "Support for GC820 basic features"
	help
	  Select this option to enable driver support for verislicon gc820
	  drivers.  GC820 is a 2D gpu. This driver enables
	  userspace programs to access these gpu hardware to configure.

	  If unsure, say N.
```

## drivers/net/ethernet/hobot/Kconfig
```kconfig
#
# Horizon network device configuration
#

config NET_VENDOR_HOBOT
	bool "Hobot ethernet devices"
	default y
	help
	  If you have a network (Ethernet) device belonging to this class, say Y.

if NET_VENDOR_HOBOT

config X2_ETH
	tristate "Hobot X2 Ethernet Device support"
	select PHYLIB
	select CRC32
	select MII
	select TSN
	depends on OF && HAS_DMA
	help
	  This driver supports the X2 Ethernet device from Hobot

config X3_ETH
	tristate "Hobot X3 Ethernet Device support"
	select PHYLIB
	select CRC32
	select MII
	select TSN
	depends on OF && HAS_DMA
	help
	  This driver supports the X3 Ethernet device from Hobot

config X5_ETH
	tristate "Hobot X5 Ethernet Device support"
	select PHYLIB
	select CRC32
	select MII
	select TSN
	depends on OF && HAS_DMA
	help
	  This driver supports the X5 Ethernet device from Hobot

endif # NET_VENDOR_HOBOT
```

## drivers/net/ethernet/horizon/Kconfig
```kconfig
#
# Horizon network device configuration
#

config NET_VENDOR_HOBOT
	bool "Hobot ethernet devices"
	default y
	help
	  If you have a network (Ethernet) device belonging to this class, say Y.

if NET_VENDOR_HOBOT

config JPLUS_ETH
	tristate "Hobot JPLUS Ethernet Device support"
	select PHYLIB
	select CRC32
	select MII
	depends on OF && HAS_DMA
	help
		This driver supports the JPLUS Ethernet device from Hobot

endif # NET_VENDOR_HOBOT
```

## drivers/phy/verisilicon/Kconfig
```kconfig
# SPDX-License-Identifier: GPL-2.0-only
#
# Phy drivers for VeriSilicon platforms
#

config PHY_SNPS_MIPI_DPHY
	tristate "Synopsys MIPI DPHY Driver"
	select GENERIC_PHY
	help
	  Enable this to support Synopsys MIPI DPHY
```

## drivers/pinctrl/hobot/Kconfig
```kconfig
# SPDX-License-Identifier: GPL-2.0
config PINCTRL_HORIZON
	bool "horizon pinctrl driver"
	select GENERIC_PINCTRL_GROUPS
	select GENERIC_PINMUX_FUNCTIONS
	select GENERIC_PINCONF
	select REGMAP
	help
	  Say Y here to enable the horizon pinctrl driver
```

## drivers/power/hobot/Kconfig
```kconfig
# SPDX-License-Identifier: GPL-2.0-only

config X5_PMU
	bool "Horizon X5 pmu support"
	default y

config X5_POWERDOMAIN
	tristate "Horizon X5 power domain support"
	depends on PM
	select PM_GENERIC_DOMAINS
	default y
```

## drivers/reset/hobot/Kconfig
```kconfig
# SPDX-License-Identifier: GPL-2.0-only

config X5_RESET
	tristate "Horizon X5 reset support"
	default y
```

## drivers/soc/hobot/Kconfig
```kconfig
#
# Hobot MPSoC configuration
#
menuconfig HOBOT_SOC_DRIVERS
        bool "HOBOT SOC drivers support"
        depends on ARCH_HOBOT

menuconfig HOBOT_SOC_DEBUG
        bool "Kernel Debugging Support on Hobot Platform"
        depends on ARCH_HOBOT
        default y
        help
          Say yes to enable the kernle debugging drivers for Hobot platform

source "drivers/soc/hobot/bpu/Kconfig"
source "drivers/soc/hobot/socinfo/Kconfig"
source "drivers/soc/hobot/reboot_reason/Kconfig"
source "drivers/soc/hobot/ddr_monitor/Kconfig"
source "drivers/soc/hobot/firewall/Kconfig"
source "drivers/soc/hobot/camera_power/Kconfig"
source "drivers/soc/hobot/dsp/Kconfig"
if HOBOT_SOC_DEBUG
source "drivers/soc/hobot/debug/Kconfig"
endif #HOBOT_SOC_DEBUG
```

## drivers/soc/hobot/bpu/Kconfig
```kconfig
#
# HOBOT BPU drivers
#
menuconfig HOBOT_BPU
	bool "HOBOT BPU subsystem support"

if HOBOT_BPU 

config BPU
	tristate "BPU framework driver"
	default y
	help
	  Say y here to support the hobot BPU(Brain Processing Unit)

	  If unsure, say N.

config BPU_ONDEMAND_GOVERNOR
	tristate "BPU OnDemand Governor"
	depends on PM_DEVFREQ
	depends on DEVFREQ_THERMAL
	depends on BPU
	default m
	help
	  Say y here to support BPU ondemand governor

	  If unsure, say y.

config BPU_CORE
	tristate "BPU Cores driver"
	depends on BPU
	default n
	help
	  Say y here to support the hobot BPU(Brain Processing Unit)

	  If unsure, say N.

config BPU_PRIO_NUM
	int "priority level number supported by BPU"
	depends on BPU
	range 1 8
	default 8
	depends on BPU_CORE
	help
	  Number of prioritys BPU support
	  if larger than soc default, use software
	  Priority mechanism, else by soc support.

endif # HOBOT_BPU 
```

## drivers/soc/hobot/camera_power/Kconfig
```kconfig
# SPDX-License-Identifier: GPL-2.0-only

config DROBOT_CAMERA_REGULATOR
	tristate "D-robot camera regualtor"
	default y
	help
	  This driver is used for drobot camera power management
```
