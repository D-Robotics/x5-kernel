// SPDX-License-Identifier: GPL-2.0
/*
 * dts for Sunrise5 EVB LP4 V1P2 board
 *
 * Copyright (C) 2024 D-Robotics Inc.
 *
 */

/dts-v1/;
#include "x5-evb.dtsi"

/ {
	model = "D-Robotics X5 EVB LP4 V1P2 board";
};
